## buildroot_default/package/Config.in
```kconfig
menu "extra packages"
	menu "Platform"
		source "package/platform_host/Config.in"
		source "package/platform_guest/Config.in"
		source "package/platform_versatile/Config.in"
		source "package/platform_raspberrypi/Config.in"
		source "package/platform_raspberrypi2/Config.in"
		source "package/platform_pandaboard/Config.in"
	endmenu

	menu "System Tools"
		source "package/initscripts/Config.in"
		source "package/busybox/Config.in"
		source "package/unionfs/Config.in"
		source "package/mdadm/Config.in"
		source "package/lxc/Config.in"
		source "package/iopclauncher/Config.in"
		source "package/dropbear/Config.in"
		source "package/advancemame/Config.in"
		source "package/rpi-firmware/Config.in"
		source "package/rpi-userland/Config.in"
		source "package/nodejs/Config.in"
		source "package/wayland/Config.in"
		source "package/weston/Config.in"
		source "package/expat/Config.in"
		source "package/eudev/Config.in"
		source "package/udev/Config.in"
		source "package/iopccfg_json/Config.in"
		source "package/iopccfg_bdb/Config.in"
		source "package/iopccmd/Config.in"
		source "package/iopcvm/Config.in"
		source "package/lvm2/Config.in"
		source "package/drbd-utils/Config.in"
		source "package/btrfs-progs/Config.in"
		source "package/e2fsprogs/Config.in"
		source "package/util-linux/Config.in"
		source "package/git/Config.in"
	endmenu

	menu "System Libraries"
		source "package/libiopctaskmqhandler/Config.in"
		source "package/libiopctasktimer/Config.in"
		source "package/libiopctaskshell/Config.in"
		source "package/libiopctaskhttp/Config.in"
		source "package/libiopctaskdb/Config.in"
		source "package/libiopccmd_system/Config.in"
		source "package/libiopccmd_client/Config.in"
		source "package/libiopccmd_network/Config.in"
		source "package/libcddaex/Config.in"
		source "package/msgpack-c/Config.in"
		source "package/leveldb/Config.in"
		source "package/berkeleydb/Config.in"
		source "package/snappy/Config.in"
#		source "package/libfuse/Config.in"
		source "package/libcap/Config.in"
		source "package/libiopccfg/Config.in"
		source "package/json-c/Config.in"
		source "package/libmicrohttpd/Config.in"
		source "package/alsa-lib/Config.in"
		source "package/libffi/Config.in"
		source "package/jpeg/Config.in"
		source "package/libpng/Config.in"
		source "package/cairo/Config.in"
		source "package/pixman/Config.in"
		source "package/fontconfig/Config.in"
		source "package/zlib/Config.in"
		source "package/lzo/Config.in"
		source "package/libxkbcommon/Config.in"
		source "package/mtdev/Config.in"
		source "package/x11r7/xkeyboard-config/Config.in"
		source "package/libiopccommon/Config.in"
	endmenu

	menu "Debug Tools"
		source "package/lshw/Config.in"
		source "package/gettext/Config.in"
	endmenu

	menu "Virtual Package"
		source "package/opengl/libegl/Config.in"
		source "package/opengl/libgles/Config.in"
		source "package/opengl/libopenmax/Config.in"
		source "package/opengl/libopenvg/Config.in"
	endmenu

	menu "Host"
		source "package/iopcmsgbus/Config.in"
		source "package/libiopcmsgbus/Config.in"
		source "package/iopccfg/Config.in"
		source "package/libiopccfg/Config.in"
		source "package/libiopccfg_host/Config.in"
		source "package/kmod_xiaomi_wifi/Config.in"
	endmenu

	menu "Web Container"
		source "package/webgui/Config.in"
		source "package/iopcmsgbus/Config.in"
		source "package/libiopcmsgbus/Config.in"
		source "package/iopccfg/Config.in"
		source "package/libiopccfg/Config.in"
	endmenu

	menu "MediaCenter Container"
		source "package/omxplayer/Config.in"
		source "package/ffmpeg2/Config.in"
		source "package/iopcmsgbus/Config.in"
		source "package/libiopcmsgbus/Config.in"
		source "package/iopccfg/Config.in"
		source "package/libiopccfg/Config.in"
		source "package/dfreerdp/Config.in"
		source "package/dial_server/Config.in"
		source "package/libgtk2_dfb/Config.in"
		source "package/webkit_dfb/Config.in"
		source "package/webkitdfb/Config.in"
	endmenu

	menu "Unit Test sources"
		source "package/kmod_hello/Config.in"
	endmenu
endmenu
```

## buildroot_default/package/dfreerdp/Config.in
```kconfig
config BR2_PACKAGE_DFREERDP
	bool "dfreerdp"
	select BR2_PACKAGE_OPENSSL
	select BR2_PACKAGE_ZLIB
	select BR2_PACKAGE_DIRECTFB
	help
	  FreeRDP is a free implementation of the Remote Desktop
	  Protocol (RDP), released under the Apache license

	  http://www.freerdp.com/
```

## buildroot_default/package/dropbear/Config.in
```kconfig
config BR2_PACKAGE_DROPBEAR
	bool "dropbear"
	select BR2_PACKAGE_ZLIB
	help
	  A small SSH 2 server designed for small memory environments.

	  http://matt.ucc.asn.au/dropbear/dropbear.html

if BR2_PACKAGE_DROPBEAR

config BR2_PACKAGE_DROPBEAR_CLIENT
	bool "client programs"
	default y
	help
	  Provides the programs: dbclient, ssh

	  Note that the following programs are also used server-side
	  and are therefore always build regardless this setting:
	  dropbear, dropbearkey, dropbearconvert, scp

config BR2_PACKAGE_DROPBEAR_DISABLE_REVERSEDNS
	bool "disable reverse DNS lookups"
	help
	  Disable reverse DNS lookups on connection. This can be handy
	  on systems without working DNS, as connections otherwise
	  stall until DNS times out.

endif
```

## buildroot_default/package/ffmpeg2/Config.in
```kconfig
comment "ffmpeg2 needs a toolchain w/ largefile, IPv6"
	depends on !(BR2_LARGEFILE && BR2_INET_IPV6) && !BR2_PACKAGE_FFMPEG2

# Warning! Moving this comment to the top of the file will make it
# appear in the ffmpeg sub-menu, dues to its dependency on ffmpeg.
# Be sure to keep it here, below the other comment above, which breaks
# the dependency chain, and thus breaks the adherence to the ffmpeg
# sub-menu.
comment "ffmpeg2 conflicts with ffmpeg"
	depends on BR2_PACKAGE_FFMPEG

menuconfig BR2_PACKAGE_FFMPEG2
	bool "ffmpeg2"
	depends on !BR2_PACKAGE_FFMPEG
	depends on BR2_LARGEFILE
	depends on BR2_INET_IPV6
	help
	  FFmpeg is a complete, cross-platform solution to record, convert
	  and stream audio and video.

	  http://www.ffmpeg.org

	  Note: the help texts of the FFmpeg2 options, below, are scrapped
	  directly from FFMpeg2's ./configure --help. Refer to the project's
	  documentation for the actual meaning of the help texts.

if BR2_PACKAGE_FFMPEG2

config BR2_PACKAGE_FFMPEG2_GPL
	bool "Enable GPL code"
	help
	  Allow use of GPL code, the resulting libs and binaries will
	  be under GPL

config BR2_PACKAGE_FFMPEG2_GPL3
	bool "Use (L)GPLv3 instead of v2"
	depends on BR2_PACKAGE_FFMPEG2_GPL
	help
	  Upgrade (L)GPL to version 3

config BR2_PACKAGE_FFMPEG2_NONFREE
	bool "Enable nonfree code"
	help
	  Allow use of nonfree code, the resulting libs and binaries
	  will be unredistributable

comment "Programs"

config BR2_PACKAGE_FFMPEG2_FFMPEG
	bool "ffmpeg"
	select BR2_PACKAGE_FFMPEG2_SWSCALE
	default y
	help
	  FFmpeg is a very fast video and audio converter.
	  It can also grab from a live audio/video source.

	  It is not needed if you want to link the FFmpeg libraries
	  to your application.

config BR2_PACKAGE_FFMPEG2_FFPLAY
	bool "ffplay"
	select BR2_PACKAGE_SDL
	help
	  FFplay is a very simple and portable media player using the
	  FFmpeg libraries and the SDL library.
	  It is mostly used as a testbed for the various FFmpeg APIs.

config BR2_PACKAGE_FFMPEG2_FFPROBE
	bool "ffprobe"
	help
	  ffprobe gathers information from multimedia streams and prints
	  it in human- and machine-readable fashion.

config BR2_PACKAGE_FFMPEG2_FFSERVER
	bool "ffserver"
	help
	  FFserver is a streaming server for both audio and video.

comment "Libraries"

config BR2_PACKAGE_FFMPEG2_AVCODEC
	bool "libavcodec"

config BR2_PACKAGE_FFMPEG2_AVDEVICE
	bool "libavdevice"

config BR2_PACKAGE_FFMPEG2_AVFILTER
	bool "libavfilter"
	select BR2_PACKAGE_FFMPEG2_AVUTIL
	select BR2_PACKAGE_FFMPEG2_AVFORMAT
	select BR2_PACKAGE_FFMPEG2_AVCODEC

config BR2_PACKAGE_FFMPEG2_AVFORMAT
	bool "libavformat"

config BR2_PACKAGE_FFMPEG2_AVRESAMPLE
	bool "libavresample"

config BR2_PACKAGE_FFMPEG2_AVUTIL
	bool "libavutil"

config BR2_PACKAGE_FFMPEG2_POSTPROC
	bool "libpostproc"
	depends on BR2_PACKAGE_FFMPEG2_GPL

config BR2_PACKAGE_FFMPEG2_SWRESAMPLE
	bool "libswresample"

config BR2_PACKAGE_FFMPEG2_SWSCALE
	bool "libswscale"

comment "Hardware acceleration"

config BR2_PACKAGE_FFMPEG2_DXVA2
	bool "dxva2"

config BR2_PACKAGE_FFMPEG2_VAAPI
	bool "vaapi"

config BR2_PACKAGE_FFMPEG2_VDA
	bool "vda"

config BR2_PACKAGE_FFMPEG2_VDPAU
	bool "vdpau"

comment "Components options"

config BR2_PACKAGE_FFMPEG2_ENCODERS
	string "Enabled encoders"
	default "all"
	help
	  Space-separated list of encoders to build in FFmpeg,
	  or "all" to build all of them.

	  Run ./configure --list-encoders in the ffmpeg sources
	  directory to know the available options.

config BR2_PACKAGE_FFMPEG2_DECODERS
	string "Enabled decoders"
	default "all"
	help
	  Space-separated list of decoders to build in FFmpeg,
	  or "all" to build all of them.

	  Run ./configure --list-decoders in the ffmpeg sources
	  directory to know the available options.

config BR2_PACKAGE_FFMPEG2_MUXERS
	string "Enabled muxers"
	default "all"
	help
	  Space-separated list of muxers to build in FFmpeg,
	  or "all" to build all of them.

	  Run ./configure --list-muxers in the ffmpeg sources
	  directory to know the available options.

config BR2_PACKAGE_FFMPEG2_DEMUXERS
	string "Enabled demuxers"
	default "all"
	help
	  Space-separated list of demuxers to build in FFmpeg,
	  or "all" to build all of them.

	  Run ./configure --list-demuxers in the ffmpeg sources
	  directory to know the available options.

config BR2_PACKAGE_FFMPEG2_PARSERS
	string "Enabled parsers"
	default "all"
	help
	  Space-separated list of parsers to build in FFmpeg,
	  or "all" to build all of them.

	  Run ./configure --list-parsers in the ffmpeg sources
	  directory to know the available options.

config BR2_PACKAGE_FFMPEG2_BSFS
	string "Enabled bitstreams"
	default "all"
	help
	  Space-separated list of bitstream filters to build in FFmpeg,
	  or "all" to build all of them.

	  Run ./configure --list-bsfs in the ffmpeg sources
	  directory to know the available options.

config BR2_PACKAGE_FFMPEG2_PROTOCOLS
	string "Enabled protocols"
	default "all"
	help
	  Space-separated list of protocols to build in FFmpeg,
	  or "all" to build all of them.

	  Run ./configure --list-protocols in the ffmpeg sources
	  directory to know the available options.

config BR2_PACKAGE_FFMPEG2_FILTERS
	string "Enabled filters"
	default "all"
	help
	  Space-separated list of filters to build in FFmpeg,
	  or "all" to build all of them.

	  Run ./configure --list-filters in the ffmpeg sources
	  directory to know the available options.

config BR2_PACKAGE_FFMPEG2_INDEVS
	string "Enabled input devices"
	default "all"
	help
	  Space-separated list of input devices to build into FFMpeg,
	  or "all" to build all of them.

	  Run ./configure --list-indevs in the ffmpeg sources
	  directory to know the available options.

config BR2_PACKAGE_FFMPEG2_OUTDEVS
	string "Enabled output devices"
	default "all"
	help
	  Space-separated list of output devices to build into FFMpeg,
	  or "all" to build all of them.

	  Run ./configure --list-outdevs in the ffmpeg sources
	  directory to know the available options.

config BR2_PACKAGE_FFMPEG2_EXTRACONF
	string "Additional parameters for ./configure"
	default ""
	help
	  Extra parameters that will be appended to FFmpeg's
	  ./configure commandline.

endif
```

## buildroot_default/package/iopccfg/Config.in
```kconfig
config BR2_PACKAGE_IOPCCFG
	bool "iopccfg"
	select BR2_PACKAGE_LIBIOPCCOMMON
	help
	  IOPC configuration util.
```

## buildroot_default/package/iopccfg_bdb/Config.in
```kconfig
config BR2_PACKAGE_IOPCCFG_BDB
	bool "iopccfg_bdb"
	select BR2_PACKAGE_LIBIOPCCOMMON
	help
	  IOPC configuration util.
```

## buildroot_default/package/iopccfg_json/Config.in
```kconfig
config BR2_PACKAGE_IOPCCFG_JSON
	bool "iopccfg_json"
	select BR2_PACKAGE_LIBIOPCCOMMON
	help
	  IOPC configuration util.
```

## buildroot_default/package/iopcmsgbus/Config.in
```kconfig
config BR2_PACKAGE_IOPCMSGBUS
	bool "iopcmsgbus"
	select BR2_PACKAGE_LIBIOPCMSGBUS
	help
	  IOPC message bus between host and gust base on uds.
```

## buildroot_default/package/kmod_hello/Config.in
```kconfig
config BR2_PACKAGE_KMOD_HELLO
	bool "kmod_hello"
	help
	  Kernel module - hello world
```

## buildroot_default/package/kmod_xiaomi_wifi/Config.in
```kconfig
config BR2_PACKAGE_KMOD_XIAOMI_WIFI
	bool "kmod_xiaomi_wifi"
	help
	  Kernel module - XIAOMI WIFI module
```

## buildroot_default/package/libcddaex/Config.in
```kconfig
config BR2_PACKAGE_LIBCDDAEX
	bool "libcddaex"
	select BR2_PACKAGE_LIBIOPCCOMMON
	help
	  The timer task library of IOPC.
```

## buildroot_default/package/libiopccfg/Config.in
```kconfig
config BR2_PACKAGE_LIBIOPCCFG
	bool "libiopccfg"
	select BR2_PACKAGE_JSON_C
	help
	  library of IOPC configuration util.
```

## buildroot_default/package/libiopccfg_host/Config.in
```kconfig
config BR2_PACKAGE_LIBIOPCCFG_HOST
	bool "libiopccfg_host"
	select BR2_PACKAGE_IOPCCFG
	help
	  IOPC Host configurations.
```

## buildroot_default/package/libiopccmd_network/Config.in
```kconfig
config BR2_PACKAGE_LIBIOPCCMD_NETWORK
	bool "libiopccmd_network"
	select BR2_PACKAGE_LIBIOPCCOMMON
	help
	  The command library of IOPC.
```

## buildroot_default/package/libiopcmsgbus/Config.in
```kconfig
config BR2_PACKAGE_LIBIOPCMSGBUS
	bool "libiopcmsgbus"
	help
	  library IOPC message bus between host and gust base on uds.
```

## buildroot_default/package/libiopctaskdb/Config.in
```kconfig
config BR2_PACKAGE_LIBIOPCTASKDB
	bool "libiopctaskdb"
	select BR2_PACKAGE_LIBIOPCCOMMON
	help
	  The db task library of IOPC.
```

## buildroot_default/package/libiopctaskhttp/Config.in
```kconfig
config BR2_PACKAGE_LIBIOPCTASKHTTP
	bool "libiopctaskhttp"
	select BR2_PACKAGE_LIBIOPCCOMMON
	select BR2_PACKAGE_LIBMICROHTTPD
	help
	  The shell task library of IOPC.
```

## buildroot_default/package/libiopctaskmqhandler/Config.in
```kconfig
config BR2_PACKAGE_LIBIOPCTASKMQHANDLER
	bool "libiopctaskmqhandler"
	select BR2_PACKAGE_LIBIOPCCOMMON
	help
	  The message queue processing task library of IOPC.
```

## buildroot_default/package/libiopctaskshell/Config.in
```kconfig
config BR2_PACKAGE_LIBIOPCTASKSHELL
	bool "libiopctaskshell"
	select BR2_PACKAGE_LIBIOPCCOMMON
	help
	  The shell task library of IOPC.
```

## buildroot_default/package/mame4all/Config.in
```kconfig
config BR2_PACKAGE_ADVANCEMAME
	bool "AdvanceMAME"
	select BR2_PACKAGE_ALSA_LIB
	help
	  This will install the advancemame emulator.
```

## buildroot_default/package/msgpack-c/Config.in
```kconfig
config BR2_PACKAGE_MSGPACK_C
	bool "msgpack-c"
	depends on BR2_INSTALL_LIBSTDCPP
	depends on BR2_ARCH_HAS_ATOMICS
	help
	  MessagePack is an efficient binary serialization format.

	  It lets you exchange data among multiple languages like JSON but
	  it's faster and smaller.

	  http://msgpack.org/

comment "msgpack needs a toolchain w/ C++"
	depends on BR2_ARCH_HAS_ATOMICS
	depends on !BR2_INSTALL_LIBSTDCPP
```
