## buildroot_default/package/platform_pandaboard/Config.in
```kconfig
config BR2_PACKAGE_PLATFORM_PANDABOARD
	bool "Platform Pandaboard"
	select BR2_PACKAGE_IOPCLAUNCHER
	depends on BR2_cortex_a9
	help
	  Platform ARM Pandaboard

if BR2_PACKAGE_PLATFORM_PANDABOARD

choice
prompt "Platform as HOST/GUEST"

config BR2_PACKAGE_PLATFORM_PANDABOARD_AS_HOST
	bool "Host"
	select BR2_PACKAGE_PLATFORM_AS_HOST
	select BR2_PACKAGE_IOPCLAUNCHER

	select BR2_PACKAGE_LXC
	select BR2_PACKAGE_DROPBEAR
	select BR2_TARGET_ROOTFS_INITRAMFS
	select BR2_TARGET_ROOTFS_IOPCLAUNCHER
	select BR2_TOOLCHAIN_EXTERNAL
	select BR2_PACKAGE_INITSCRIPTS

config BR2_PACKAGE_PLATFORM_PANDABOARD_AS_GUEST
	bool "Guest"
	select BR2_PACKAGE_PLATFORM_AS_GUEST
	select BR2_PACKAGE_INITSCRIPTS

endchoice

endif
```

## buildroot_default/package/platform_raspberrypi/Config.in
```kconfig
config BR2_PACKAGE_PLATFORM_RASPBERRYPI
	bool "Platform RaspberryPi"
	depends on BR2_arm1176jzf_s
	help
	  Platform ARM RaspberryPi.

if BR2_PACKAGE_PLATFORM_RASPBERRYPI

choice
prompt "Platform as HOST/GUEST"

config BR2_PACKAGE_PLATFORM_RASPBERRYPI_AS_HOST
	bool "Host"
	select BR2_PACKAGE_PLATFORM_AS_HOST
	select BR2_PACKAGE_IOPCLAUNCHER
	select BR2_PACKAGE_MDADM
	select BR2_PACKAGE_LXC
	select BR2_PACKAGE_DROPBEAR
	select BR2_TARGET_ROOTFS_INITRAMFS
	select BR2_TARGET_ROOTFS_IOPCLAUNCHER
	select BR2_TOOLCHAIN_EXTERNAL
	#select BR2_TOOLCHAIN_EXTERNAL_LINARO_ARM
	#select BR2_PACKAGE_LIBMICROHTTPD
	select BR2_PACKAGE_INITSCRIPTS
	select BR2_PACKAGE_RPI_FIRMWARE

config BR2_PACKAGE_PLATFORM_RASPBERRYPI_AS_GUEST
	bool "Guest"
	select BR2_PACKAGE_PLATFORM_AS_GUEST
	select BR2_PACKAGE_INITSCRIPTS
	#select BR2_PACKAGE_RPI_USERLAND

endchoice

endif
```

## buildroot_default/package/platform_raspberrypi2/Config.in
```kconfig
config BR2_PACKAGE_PLATFORM_RASPBERRYPI2
	bool "Platform RaspberryPi2"
	select BR2_PACKAGE_IOPCLAUNCHER
	depends on BR2_cortex_a7
	help
	  Platform ARM RaspberryPi2.

if BR2_PACKAGE_PLATFORM_RASPBERRYPI2

choice
prompt "Platform as HOST/GUEST"

config BR2_PACKAGE_PLATFORM_RASPBERRYPI2_AS_HOST
	bool "Host"
	select BR2_PACKAGE_PLATFORM_AS_HOST
	select BR2_PACKAGE_MDADM
	select BR2_PACKAGE_LXC
	select BR2_PACKAGE_DROPBEAR
	select BR2_TARGET_ROOTFS_INITRAMFS
	select BR2_TARGET_ROOTFS_IOPCLAUNCHER
	select BR2_TOOLCHAIN_EXTERNAL
	#select 
	#select BR2_PACKAGE_LIBMICROHTTPD
	select BR2_PACKAGE_INITSCRIPTS
	select BR2_PACKAGE_RPI_FIRMWARE

config BR2_PACKAGE_PLATFORM_RASPBERRYPI2_AS_GUEST
	bool "Guest"
	select BR2_PACKAGE_PLATFORM_AS_GUEST
	select BR2_PACKAGE_INITSCRIPTS
	#select BR2_PACKAGE_RPI_USERLAND

endchoice

endif
```

## buildroot_default/package/platform_versatile/Config.in
```kconfig
config BR2_PACKAGE_PLATFORM_VERSATILE
	bool "Platform Versatile Host"
	depends on BR2_arm926t
	help
	  Platform ARM versatile.

if BR2_PACKAGE_PLATFORM_VERSATILE

choice
prompt "Platform as HOST/GUEST"

config BR2_PACKAGE_PLATFORM_VERSATILE_AS_HOST
	bool "Host"
	select BR2_PACKAGE_PLATFORM_AS_HOST
	select BR2_PACKAGE_IOPCLAUNCHER
#	select BR2_PACKAGE_MDADM
	select BR2_PACKAGE_LXC
	select BR2_PACKAGE_DROPBEAR
	select BR2_TARGET_ROOTFS_INITRAMFS
	select BR2_TARGET_ROOTFS_IOPCLAUNCHER
	select BR2_TOOLCHAIN_EXTERNAL
#	select BR2_PACKAGE_LIBIOPCTASKMQHANDLER
#	select BR2_PACKAGE_LIBIOPCTASKTIMER
	#select BR2_TOOLCHAIN_EXTERNAL_CODESOURCERY_ARM201405
	#select BR2_PACKAGE_LIBMICROHTTPD
	select BR2_PACKAGE_INITSCRIPTS

config BR2_PACKAGE_PLATFORM_VERSATILE_AS_GUEST
	bool "Guest"
	select BR2_PACKAGE_PLATFORM_AS_GUEST
#	select BR2_PACKAGE_LIBIOPCTASKMQHANDLER
#	select BR2_PACKAGE_LIBIOPCTASKTIMER
	select BR2_PACKAGE_INITSCRIPTS

endchoice

endif
```

## buildroot_default/package/platform_x86_64/Config.in
```kconfig
config BR2_PACKAGE_PLATFORM_X86_64
	bool "Platform Versatile Host"
	depends on BR2_x86_64
	help
	  Platform X86 64bit.

if BR2_PACKAGE_PLATFORM_X86_64

choice
prompt "Platform as HOST/GUEST"

config BR2_PACKAGE_PLATFORM_X86_64_AS_HOST
	bool "Host"
	select BR2_PACKAGE_PLATFORM_AS_HOST
	select BR2_PACKAGE_IOPCLAUNCHER
#	select BR2_PACKAGE_MDADM
	select BR2_PACKAGE_LXC
	select BR2_PACKAGE_DROPBEAR
	select BR2_TARGET_ROOTFS_INITRAMFS
	select BR2_TARGET_ROOTFS_IOPCLAUNCHER
	select BR2_TOOLCHAIN_EXTERNAL
#	select BR2_PACKAGE_LIBIOPCTASKMQHANDLER
#	select BR2_PACKAGE_LIBIOPCTASKTIMER
	#select BR2_TOOLCHAIN_EXTERNAL_CODESOURCERY_ARM201405
	#select BR2_PACKAGE_LIBMICROHTTPD
	select BR2_PACKAGE_INITSCRIPTS

config BR2_PACKAGE_PLATFORM_X86_64_AS_GUEST
	bool "Guest"
	select BR2_PACKAGE_PLATFORM_AS_GUEST
#	select BR2_PACKAGE_LIBIOPCTASKMQHANDLER
#	select BR2_PACKAGE_LIBIOPCTASKTIMER
	select BR2_PACKAGE_INITSCRIPTS

endchoice

endif
```

## buildroot_default/package/webkit_dfb/Config.in
```kconfig
config BR2_PACKAGE_WEBKIT_ARCH_SUPPORTS
	bool
	# ARM needs BLX, so v5t+
	default y if (BR2_arm || BR2_armeb) && !BR2_ARM_CPU_ARMV4
	default y if BR2_i386 || BR2_mips || BR2_mipsel || \
		BR2_sparc || BR2_x86_64
	depends on BR2_USE_MMU # libgail -> pango -> libglib2


config BR2_PACKAGE_WEBKIT_DFB
	bool "webkit_dfb"
	#depends on BR2_INSTALL_LIBSTDCPP
	#depends on BR2_USE_WCHAR # enchant -> libglib2
	#depends on BR2_TOOLCHAIN_HAS_THREADS # enchant -> libglib2; icu
	#depends on BR2_PACKAGE_LIBGTK2
	#depends on BR2_PACKAGE_WEBKIT_ARCH_SUPPORTS
	#depends on !BR2_BINFMT_FLAT # icu
	#depends on BR2_ARCH_HAS_ATOMICS # cairo
	select BR2_PACKAGE_CAIRO
	select BR2_PACKAGE_CAIRO_PNG
	select BR2_PACKAGE_ENCHANT
	select BR2_PACKAGE_HARFBUZZ
	select BR2_PACKAGE_ICU
	select BR2_PACKAGE_JPEG
	select BR2_PACKAGE_LIBCURL
	select BR2_PACKAGE_LIBGAIL
	select BR2_PACKAGE_LIBSECRET
	select BR2_PACKAGE_LIBSOUP
	select BR2_PACKAGE_LIBXML2
	select BR2_PACKAGE_LIBXSLT
	select BR2_PACKAGE_SQLITE
	select BR2_PACKAGE_WEBP
	help
	  WebKit is an open source, standards compliant web browser engine.

	  Note that WebKit does not build with a toolchain using the
	  old linuxthreads library.

	  http://webkit.org/
```

## buildroot_default/package/webkitdfb/Config.in
```kconfig
config BR2_PACKAGE_WEBKITDFB
	bool "webkitdfb"
	select BR2_PACKAGE_DIRECTFB
	select BR2_PACKAGE_LITE
	select BR2_PACKAGE_LIBXML2
	select BR2_PACKAGE_SQLITE
	select BR2_PACKAGE_LIBXSLT
	select BR2_PACKAGE_ICU
	select BR2_PACKAGE_LIBGLIB2
	select BR2_PACKAGE_LIBCURL
	select BR2_PACKAGE_HARFBUZZ
	help
	  Webkit DirectFB.
```
